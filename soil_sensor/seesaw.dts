/dts-v1/;
/plugin/;

/ {
	compatible = "brcm,bcm2711";
	
	fragment@0 {
		target = <&i2c1>; /* Fragment targets the i2c1 node */
		__overlay__ {
			seesaw: seesaw@36{
				compatible = "adafruit,seesaw";
				reg = <0x36>;
				status = "okay";
			};
		};
	};
};
