/dts-v1/;
/plugin/;

/ {
	compatible = "brcm,bcm2711";
	
	fragment@0 {
		target = <&i2c1>; /* Fragment targets the i2c1 node */
		__overlay__ {
			stemma: stemma@36{
				compatible = "arrow,stemma";
				reg = <0x36>;
				status = "okay";
			};
		};
	};
};
